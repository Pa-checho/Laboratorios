.include "m328pdef.inc"

;CONSTANTES
.equ F_CPU    = 16000000
.equ BAUD     = 9600
.equ UBRR_VAL = 103

.cseg
.org 0x0000
    rjmp INICIO

INICIO:
    ;Configurar Puertos físicos (Pines del DAC)
    ldi r16, 0xFC      ; Pines PD2 a PD7 como salida
    out DDRD, r16
    ldi r16, 0x03      ; Pines PB0 y PB1 como salida
    out DDRB, r16

    ;Configurar Puerto Serie (UART) SOLO para RECIBIR
    ldi r16, HIGH(UBRR_VAL)
    sts UBRR0H, r16
    ldi r16, LOW(UBRR_VAL)
    sts UBRR0L, r16
    ldi r16, (1<<RXEN0) ;Habilitar solo receptor (RX)
    sts UCSR0B, r16
    ldi r16, (1<<UCSZ01) | (1<<UCSZ00) ; Formato de 8 bits
    sts UCSR0C, r16

    ;Configurar Temporizador (Timer0)
    ldi r16, (1<<WGM01)
    out TCCR0A, r16
    ldi r16, (1<<CS01) | (1<<CS00) ;Prescaler 64
    out TCCR0B, r16
    ldi r16, 249       ;Contar hasta 249
    out OCR0A, r16

    ;Empezar por defecto con la Señal 1
    rjmp CARGAR_S1

;PREPARACIÓN DE LAS SEÑALES
CARGAR_S1:
    ldi ZL, LOW(SENAL_1 * 2)  ;Apuntar a la tabla de Señal 1
    ldi ZH, HIGH(SENAL_1 * 2)
    ldi r20, 0                ;r20 es nuestro contador (0 equivale a 256)
    ldi r21, 1                ;r21 recuerda que estamos en la señal 1
    rjmp BUCLE_PRINCIPAL

CARGAR_S9:
    ldi ZL, LOW(SENAL_9 * 2)  ;Apuntar a la tabla de Señal 9
    ldi ZH, HIGH(SENAL_9 * 2)
    ldi r20, 32               ;r20 es nuestro contador (32 muestras)
    ldi r21, 9                ;r21 recuerda que estamos en la señal 9
    rjmp BUCLE_PRINCIPAL

;BUCLE(Se repite infinitamente)
BUCLE_PRINCIPAL:

    in r16, TIFR0             ;Leer registro de banderas del timer
    sbrs r16, OCF0A           ;La bandera de tiempo dice 1
    rjmp REVISAR_SERIAL       ;No -> saltar a revisar el teclado

    ;Si el código llega aca, Si pasó 1 milisegundo
    ;Bajar la bandera del timer (escribiéndole un 1)
    ldi r16, (1<<OCF0A)
    out TIFR0, r16

    ;Leer el valor de la onda y avanzar el puntero automáticamente (Z+)
    lpm r16, Z+

    ;Enviar bits 0 al 5 al PORTD
    mov r18, r16
    lsl r18
    lsl r18                   ;Rodar 2 posiciones a la izquierda
    out PORTD, r18

    ;Enviar bits 6 y 7 al PORTB
    mov r19, r16
    lsr r19
    lsr r19
    lsr r19
    lsr r19
    lsr r19
    lsr r19                   ;Rodar 6 posiciones a la derecha
    out PORTB, r19

    ;Restar 1 al contador de muestras
    dec r20
    brne REVISAR_SERIAL       ;Si aún no llega a 0, seguir normalmente

    ;Si el contador llegó a 0, la onda terminó y hay que empezarla de nuevo
    cpi r21, 1                ;Estábamos reproduciendo la señal 1?
    breq CARGAR_S1            ; Sí -> Recargar señal 1
    rjmp CARGAR_S9            ; No -> Recargar señal 9


REVISAR_SERIAL:
    lds r16, UCSR0A
    sbrs r16, RXC0            ;Llegó un dato por el cable USB/Serie
    rjmp BUCLE_PRINCIPAL      ;No -> Volver al inicio del bucle

    ;Sí llegó un dato, lo leemos
    lds r16, UDR0             ;Guardar la tecla presionada en r16

    cpi r16, '1'
    breq CARGAR_S1            ;Si es '1', cambiar a Señal 1

    cpi r16, '9'
    breq CARGAR_S9            ;Si es '9', cambiar a Señal 9

    ;Si presiona otra tecla, la ignora
    rjmp BUCLE_PRINCIPAL



;DATOS EN MEMORIA FLASH

;32 muestras
;Frecuenccia 1/0,032
;F= 31,25 Hz
SENAL_9:
    .db 0x00, 0x01, 0x02, 0x03, 0x05, 0x07, 0x0a, 0x0e
    .db 0x13, 0x19, 0x21, 0x2b, 0x37, 0x46, 0x58, 0x6d
    .db 0x85, 0xa0, 0xbf, 0xe2, 0xff, 0xff, 0xff, 0xff
    .db 0xff, 0xff, 0xff, 0xff, 0xff, 0xff, 0xff, 0xff

;256 muestras
;Frecuencia 1/0,256
;F = 3,91 Hz
SENAL_1:
    .db 0x80, 0x83, 0x86, 0x89, 0x8c, 0x8f, 0x92, 0x95, 0x98, 0x9c, 0x9f, 0xa2, 0xa5, 0xa8, 0xab, 0xae
    .db 0xb0, 0xb3, 0xb6, 0xb9, 0xbc, 0xbf, 0xc1, 0xc4, 0xc7, 0xc9, 0xcc, 0xce, 0xd1, 0xd3, 0xd5, 0xd8
    .db 0xda, 0xdc, 0xde, 0xe0, 0xe2, 0xe4, 0xe6, 0xe8, 0xea, 0xec, 0xed, 0xef, 0xf0, 0xf2, 0xf3, 0xf5
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    .db 0x4f, 0x51, 0x54, 0x57, 0x5a, 0x5d, 0x60, 0x63, 0x67, 0x6a, 0x6d, 0x70, 0x73, 0x76, 0x79, 0x7c